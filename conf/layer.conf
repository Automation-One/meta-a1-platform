## conf/layer.conf
```bitbake
# We have a conf and classes directory, add to BBPATH
BBPATH .= ":${LAYERDIR}"

# We have a packages directory, add to BBFILES
BBFILES += "${LAYERDIR}/recipes-*/*/*.bb"
BBFILES += "${LAYERDIR}/recipes-*/*/*.bbappend"

BBFILE_COLLECTIONS += "meta-a1-gw-bsp"
BBFILE_PATTERN_meta-a1-gw-bsp = "^${LAYERDIR}/"
BBFILE_PRIORITY_meta-a1-gw-bsp = "5"

LAYERDEPENDS_meta-a1-gw-bsp = "core mainlinecommon-layer"
LAYERSERIES_COMPAT_meta-a1-gw-bsp = "scarthgap"
```

## conf/machine/a1-imx6ull-gw.conf
```bitbake
#@TYPE: Machine
#@NAME: A1 IMX6ULL GW
#@SOC:  NXP IMX6ULL
#@DESCRIPTION: Machine configuration for A1 IMX6ULL GW gateway


require conf/machine/include/a1-imx6ull-common.inc

# U-Boot bootloader
UBOOT_MACHINE = "kontron-sl-mx6ul_defconfig"


MACHINE_ESSENTIAL_EXTRA_RDEPENDS += " \
    linux-firmware-rs9113 \
  "

# Linux kernel
KERNEL_DEVICETREE = " \
	nxp/imx/imx6ull-a1-gw.dtb \
	"

# NAND Settings
MKUBIFS_ARGS = "-F -m 4096 -e 253952 -c 950 -x favor_lzo -X 5"
MKUBIFS_ARGS_INTERNAL = "-F -m 4096 -e 253952 -c 100 -x favor_lzo -X 5"
UBINIZE_ARGS = "-m 4096 -p 262144 -s 4096"
UBI_VOLNAME = "spi-nand0"
```

## conf/machine/include/a1-imx-common.inc
```bitbake
MACHINEOVERRIDES =. "a1-gw:a1-imx-gw:"

MACHINE_FEATURES ?= "apm serial usbhost 3g"

# U-Boot bootloader
UBOOT_ENV = "boot"
UBOOT_ENV_SUFFIX = "scr"
PREFERRED_PROVIDER_virtual/bootloader := "u-boot-mainline"
PREFERRED_PROVIDER_u-boot := "u-boot-mainline"
PREFERRED_PROVIDER_u-boot-native ?= "u-boot-mainline"
PREFERRED_PROVIDER_u-boot-fw-utils ?= "u-boot-mainline-fw-utils"
PREFERRED_PROVIDER_u-boot-fw-utils-native ?= "u-boot-mainline-fw-utils-native"
PREFERRED_PROVIDER_u-boot-tools ?= "u-boot-mainline-tools"
PREFERRED_PROVIDER_u-boot-tools-native ?= "u-boot-mainline-tools-native"
PREFERRED_PROVIDER_u-boot-mkimage-native ?= "u-boot-mainline-tools-native"

UBOOT_MAINLINE_VERSION = "2024.04%"
PREFERRED_VERSION_u-boot-mainline ?= "${UBOOT_MAINLINE_VERSION}"
PREFERRED_VERSION_u-boot-mainline-native ?= "${UBOOT_MAINLINE_VERSION}"
PREFERRED_VERSION_u-boot-mainline-fw-utils ?= "${UBOOT_MAINLINE_VERSION}"
PREFERRED_VERSION_u-boot-mainline-fw-utils-native ?= "${UBOOT_MAINLINE_VERSION}"
PREFERRED_VERSION_u-boot-mainline-tools ?= "${UBOOT_MAINLINE_VERSION}"
PREFERRED_VERSION_u-boot-mainline-tools-native ?= "${UBOOT_MAINLINE_VERSION}"


# Linux kernel
KERNEL_IMAGETYPE = "fitImage"
KERNEL_CLASSES += " kernel-fitimage "
PREFERRED_PROVIDER_virtual/kernel ?= "linux-stable"


# Ship kernel modules
MACHINE_ESSENTIAL_EXTRA_RDEPENDS += " \
	kernel-modules kernel-devicetree \
	"

# List of images to be built
IMAGE_FSTYPES ?= "tar.xz wic.xz wic.gz"
#TODO: UBIFS
INITRAMFS_FSTYPES ?= "cpio.xz"

EXTRA_IMAGEDEPENDS += "u-boot-mainline"
IMAGE_BOOT_FILES ?= "${KERNEL_IMAGETYPE}"
IMAGE_INSTALL:append = " kernel-devicetree kernel-image-fitimage u-boot-mainline"
do_image_wic[depends] += "mtools-native:do_populate_sysroot dosfstools-native:do_populate_sysroot u-boot-mainline:do_deploy"

# Add any optional config files that might be present e.g. in other layers
include conf/machine/${MACHINE}-extra.conf
```

## conf/machine/include/a1-imx6ull-common.inc
```bitbake
MACHINEOVERRIDES =. "a1-imx6ull-gw:"

require conf/machine/include/a1-imx-common.inc

DEFAULTTUNE ?= "cortexa7thf-neon-vfpv4"
SOC_FAMILY ?= "imx6ull"

include conf/machine/include/arm/armv7a/tune-cortexa7.inc
require conf/machine/include/soc-family.inc

SERIAL_CONSOLES = "115200;ttymxc3"

# Linux kernel
PREFERRED_VERSION_linux-stable ?= "6.6%"
KERNEL_DTBVENDORED = "0"
KERNEL_DTC_FLAGS += "-@"

# U-Boot bootloader
UBOOT_ENTRYPOINT = "0x81000000"
UBOOT_MAKE_TARGET := "flash.bin"
UBOOT_BINARY := "flash.bin"
UBOOT_SUFFIX ?= "bin"

WKS_FILE = "sdimage-imx6ull.wks"

MACHINE_ESSENTIAL_EXTRA_RDEPENDS += " \
    linux-firmware-imx-sdma-imx6q \
  "

# Add any optional config files that might be present e.g. in other layers
include conf/machine/include/ux-imx6ull-common-extra.inc
```

## scripts/lib/wic/canned-wks/sdimage-imx6ull-AB.wks
```
# short-description: Create an SD card image for AutomationOne IMX6ULL with A/B system
# long-description: This script creates a partitioned SD card image for the AutomationOne IMX6ULL platform.
# It includes a bootloader partition, two root filesystem partitions for A/B system updates, and a data partition.

# Bootloader
part --source rawcopy --sourceparams="file=flash.bin" --ondisk mmcblk --no-table --align 1 --size 2M

# First rootfs partition
part --source rootfs --ondisk mmcblk0 --fstype=ext4 --label rootfsA --size 256M

# Second rootfs partition (for A/B system or similar)
part --source rootfs --ondisk mmcblk0 --fstype=ext4 --label rootfsB --size=256M

# Data partition
part /data --ondisk mmcblk0 --fstype=ext4 --label data --size=256M
```

## scripts/lib/wic/canned-wks/sdimage-imx6ull.wks
```
# short-description: Create AutomationOne IMX6ULL SD card image with a boot partition
# long-description: Creates a partitioned SD card image. Boot files
# are located in the first ext4 partition.

part --source rawcopy --sourceparams="file=flash.bin" --ondisk mmcblk --no-table --align 1 --size 2M
part / --source rootfs --ondisk mmcblk0 --fstype=ext4 --label root --active --align 4096
```
